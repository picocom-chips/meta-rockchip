## conf/machine/pc806scb.conf
```bitbake
# Copyright (c) 2019, Fuzhou Rockchip Electronics Co., Ltd
# Released under the MIT license (see COPYING.MIT for the terms)

#@TYPE: Machine
#@NAME: Picocom PC806 SCB

require conf/machine/include/rk3399.inc

PREFERRED_VERSION_linux-rockchip := "5.10%"
LINUXLIBCVERSION := "5.10-custom%"

KBUILD_DEFCONFIG = "picocom_pc806scb_defconfig"
KERNEL_DEVICETREE = "rockchip/picocom-pc806scb.dtb"
ROCKCHIP_KERNEL_COMPRESSED = "0"
UBOOT_MACHINE = "rk3399_defconfig"

ENABLE_PREEMPT_RT = 'true'

MACHINE_EXTRA_RRECOMMENDS:append = " \
	linux-firmware-rk-cdndp \
	rockchip-npu \
"
```
